## boards/shields/zest-radio-gnss/Kconfig.shield
```kconfig
# Copyright (c) 2024 CATIE
# SPDX-License-Identifier: Apache-2.0

config SHIELD_ZEST_RADIO_GNSS
	def_bool $(shields_list_contains,zest_sensor_gnss)
```
